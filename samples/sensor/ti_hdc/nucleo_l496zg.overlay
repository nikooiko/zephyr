/*
 * Copyright (c) 2019 Centaur Analytics, Inc
 *
 * SPDX-License-Identifier: Apache-2.0
 */

&i2c1 {

	ti_hdc: ti_hdc@40 {
		compatible = "ti,hdc","ti,hdc1080";
		reg = <0x40>;
		label = "HDC1080";
	};

};
