/*
 * Copyright (c) 2019 Nikos Oikonomou <nikoikonomou92@gmail.com>
 *
 * SPDX-License-Identifier: Apache-2.0
 */

&spi1 {
	status = "ok";
	cs-gpios = <&gpioa 1 (GPIO_DIR_OUT|GPIO_INT_ACTIVE_LOW)>;

	s2lp@0 {
		compatible = "st,s2lp";
		reg = <0x0>;
		label = "s2lp";
		spi-max-frequency = <4000000>;
		sdn-gpios = <&gpioa 8 (GPIO_DIR_OUT|GPIO_INT_ACTIVE_LOW)>;
		rx-rdy-irq-gpios = <&gpioc 0 (GPIO_DIR_IN|GPIO_INT|
			GPIO_INT_EDGE|GPIO_PUD_PULL_UP|GPIO_INT_ACTIVE_LOW)>;
	};
};